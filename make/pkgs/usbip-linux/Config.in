## make/pkgs/usbip-linux/Config.in
```kconfig
config FREETZ_PACKAGE_USBIP_LINUX
	bool "USB/IP - Linux Kernel Version"
	depends on FREETZ_REPLACE_MODULE_AVAILABLE
	default n
	# select FREETZ_LIB_libglib_2
	select FREETZ_LIB_libsysfs
	select FREETZ_MODULE_usbip_core if !FREETZ_AVM_HAS_USB_IP_HOST_BUILTIN
	select FREETZ_MODULE_usbip_host if !FREETZ_AVM_HAS_USB_IP_HOST_BUILTIN
	select FREETZ_PACKAGE_USBIDS
	help
		USB/IP Project aims to develop a general USB
		device sharing system over IP network. To share
		USB devices between computers with their full
		functionality, USB/IP encapsulates "USB I/O messages"
		into IP packets and transmits them between computers.

		If you plan to share a printer with this package, consider
		to remove AVM's printserv, but not the usblp kernel module.
```
